	LIST		p=16f877A 
	INCLUDE 	<p16f877A.inc> 
 
BIRLER	EQU	20H
ONLAR	EQU	21H
YUZLER	EQU 22H
BINLER	EQU	23H
S1		EQU	24H
S2		EQU 25H
S3		EQU	26H
DOKUZ	EQU	27H

	ORG 	0x00
	GOTO 	BASLA

BASLA
	BANKSEL TRISB
	CLRF 	TRISB
	CLRF	TRISD
	BANKSEL PORTB
	CLRF 	PORTB 
	CLRF 	PORTD
	
	MOVLW	.0
	MOVWF	BINLER
	MOVLW	.0
	MOVWF	YUZLER
	MOVLW	.0
	MOVWF	ONLAR
	MOVLW	.0
	MOVWF	BIRLER
	MOVLW 	.9
	MOVWF	DOKUZ

LOOP
	CALL 	GOSTER 
	CALL 	ARTIS
	GOTO 	LOOP
	
GOSTER
	MOVF    BINLER,W
	MOVWF	PORTD
	MOVLW	B'00000001'
	MOVWF	PORTB
	CALL 	GECIKME
	
	MOVF	YUZLER,W
	MOVWF	PORTD
	MOVLW	B'00000010'
	MOVWF	PORTB
	CALL 	GECIKME
	
	MOVF	ONLAR,W
	MOVWF	PORTD
	MOVLW	B'00000100'
	MOVWF	PORTB
	CALL 	GECIKME
	
	MOVF	BIRLER,W
	MOVWF	PORTD
	MOVLW	B'00001000'
	MOVWF	PORTB
	CALL 	GECIKME
	RETURN

ARTIS
	INCF 	BIRLER,1
	GOTO 	KONTROL_ONLAR
	RETURN

KONTROL_ONLAR
	BCF		STATUS,C
	MOVF	BIRLER,W
	SUBWF	DOKUZ,W	
	BTFSS	STATUS,C
	GOTO 	ONLUK_ARTIS
	RETURN

ONLUK_ARTIS
	MOVLW	.0
	MOVWF	BIRLER
	INCF	ONLAR,1
	GOTO 	KONTROL_YUZLER
	RETURN

KONTROL_YUZLER
	BCF		STATUS,C
	MOVF	ONLAR,W
	SUBWF	DOKUZ,W
	BTFSS	STATUS,C
	GOTO 	YUZLER_ARTIR
	RETURN	

YUZLER_ARTIR
	MOVLW	.0
	MOVWF	ONLAR
	INCF	YUZLER,1
	GOTO 	KONTROL_BINLER
	RETURN

KONTROL_BINLER
	BCF		STATUS,C
	MOVF	YUZLER,W
	SUBWF	DOKUZ,W
	BTFSS	STATUS,C
	GOTO	BINLER_ARTIR
	RETURN	

BINLER_ARTIR
	MOVLW	.0
	MOVWF	YUZLER
	INCF	BINLER
	GOTO 	KONTROL_BINLER2

KONTROL_BINLER2
	BCF		STATUS,C
	MOVF	BINLER,W
	SUBWF	DOKUZ,W
	BTFSS	STATUS,C
	GOTO 	SIFIRLA
	RETURN

SIFIRLA
	MOVLW	.0
	MOVWF	BINLER
	RETURN

GECIKME
	MOVLW	.10
	MOVWF	S1	
GECIKME1
	MOVLW	.50
	MOVWF	S2
GECIKME2
	MOVLW	.50
	MOVWF	S3
GECIKME3
	DECFSZ 	S3,F
	GOTO 	GECIKME3
	DECFSZ	S2,F
	GOTO	GECIKME2
	DECFSZ	S1,F
	GOTO	GECIKME1
	RETURN
	END
