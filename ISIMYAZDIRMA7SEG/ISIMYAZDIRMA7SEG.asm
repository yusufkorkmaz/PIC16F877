	LIST		p=16f877A 
	INCLUDE 	<p16f877A.inc> 
 
BIRLER	EQU	20H
ONLAR	EQU	21H
YUZLER	EQU 22H
BINLER	EQU	23H
S1		EQU	24H
S2		EQU 25H
S3		EQU	26H

	ORG 	0x00
	GOTO 	BASLA

BASLA
	BANKSEL TRISB
	CLRF 	TRISB
	CLRF	TRISD
	BANKSEL PORTB
	CLRF 	PORTB 
	CLRF 	PORTD 
LOOP
	CALL 	GOSTER
	GOTO 	LOOP

HARFLER
	
GOSTER
	
	MOVLW	b'1110111'
	MOVWF	PORTB
	MOVLW	b'11111110'
	MOVWF	PORTD
	CALL 	GECIKME  

	MOVLW	b'0111000'
	MOVWF	PORTB
	MOVLW	b'11111101'
	MOVWF	PORTD
	CALL 	GECIKME 

	MOVLW	b'1110011'
	MOVWF	PORTB
	MOVLW	b'11111011'
	MOVWF	PORTD
	CALL 	GECIKME 

	MOVLW	b'1111001'
	MOVWF	PORTB
	MOVLW	b'11110111'
	MOVWF	PORTD
	CALL 	GECIKME 

	MOVLW	b'1110111'
	MOVWF	PORTB
	MOVLW	b'11101111'
	MOVWF	PORTD
	CALL 	GECIKME  

	RETURN

GECIKME
	MOVLW	.7
	MOVWF	S1	
GECIKME1
	MOVLW	.50
	MOVWF	S2
GECIKME2
	MOVLW	.50
	MOVWF	S3
GECIKME3
	DECFSZ 	S3,F
	GOTO 	GECIKME3
	DECFSZ	S2,F
	GOTO	GECIKME2
	DECFSZ	S1,F
	GOTO	GECIKME1
	RETURN
	END
